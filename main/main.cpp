#include <stdio.h>
#include <math.h>
#include "freertos/FreeRTOS.h"
#include "freertos/task.h"
#include "freertos/queue.h"
#include "driver/ledc.h"
#include "driver/i2c.h"
#include "driver/gpio.h"
#include "edge_ai_model/edge-impulse-sdk/classifier/ei_run_classifier.h"

// ==========================================
// Hardware settings (motor & I2C)
// ==========================================
#define MOTOR_PWM_PIN       12
#define LEDC_TIMER          LEDC_TIMER_0
#define LEDC_MODE           LEDC_LOW_SPEED_MODE
#define LEDC_CHANNEL        LEDC_CHANNEL_0
#define LEDC_DUTY_RES       LEDC_TIMER_8_BIT
#define LEDC_FREQUENCY      5000

#define I2C_MASTER_SCL_IO           43
#define I2C_MASTER_SDA_IO           44
#define I2C_MASTER_NUM              I2C_NUM_0
#define I2C_MASTER_FREQ_HZ          100000

#define MPU6050_ADDR                0x68
#define MPU6050_PWR_MGMT_1          0x6B
#define MPU6050_WHO_AM_I            0x75
#define MPU6050_ACCEL_XOUT_H        0x3B

#define LED_GREEN_PIN  GPIO_NUM_18
#define LED_ORANGE_PIN GPIO_NUM_17
#define LED_RED_PIN    GPIO_NUM_21

// ==========================================
// Memory & RTOS
// ==========================================
// IMPORTANT: must stay 256. The model expects 128 FFT magnitude bins,
// and magnitude bins = BUFFER_SIZE / 2. Changing this breaks the model input size.
#define BUFFER_SIZE 256
#define NUM_BUFFERS 2

static float accel_data_buffer[NUM_BUFFERS][BUFFER_SIZE];
static QueueHandle_t ready_buffer_queue;

// ------------------------------------------
// Hardware init
// ------------------------------------------

void init_motor_pwm(void) {
    ledc_timer_config_t ledc_timer = {};
    ledc_timer.speed_mode       = LEDC_MODE;
    ledc_timer.timer_num        = LEDC_TIMER;
    ledc_timer.duty_resolution  = LEDC_DUTY_RES;
    ledc_timer.freq_hz          = LEDC_FREQUENCY;
    ledc_timer.clk_cfg          = LEDC_AUTO_CLK;
    ledc_timer_config(&ledc_timer);

    ledc_channel_config_t ledc_channel = {};
    ledc_channel.speed_mode     = LEDC_MODE;
    ledc_channel.channel        = LEDC_CHANNEL;
    ledc_channel.timer_sel      = LEDC_TIMER;
    ledc_channel.intr_type      = LEDC_INTR_DISABLE;
    ledc_channel.gpio_num       = MOTOR_PWM_PIN;
    ledc_channel.duty           = 0;
    ledc_channel.hpoint         = 0;
    ledc_channel_config(&ledc_channel);
}

void init_leds(void) {
    gpio_reset_pin(LED_GREEN_PIN);
    gpio_set_direction(LED_GREEN_PIN, GPIO_MODE_OUTPUT);
    gpio_reset_pin(LED_ORANGE_PIN);
    gpio_set_direction(LED_ORANGE_PIN, GPIO_MODE_OUTPUT);
    gpio_reset_pin(LED_RED_PIN);
    gpio_set_direction(LED_RED_PIN, GPIO_MODE_OUTPUT);

    gpio_set_level(LED_GREEN_PIN, 1);
    gpio_set_level(LED_ORANGE_PIN, 0);
    gpio_set_level(LED_RED_PIN, 0);
}

void i2c_master_init(void) {
    i2c_port_t i2c_master_port = (i2c_port_t)I2C_MASTER_NUM;

    i2c_config_t conf = {};
    conf.mode = I2C_MODE_MASTER;
    conf.sda_io_num = I2C_MASTER_SDA_IO;
    conf.scl_io_num = I2C_MASTER_SCL_IO;
    conf.sda_pullup_en = GPIO_PULLUP_ENABLE;
    conf.scl_pullup_en = GPIO_PULLUP_ENABLE;
    conf.master.clk_speed = I2C_MASTER_FREQ_HZ;

    i2c_param_config(i2c_master_port, &conf);
    i2c_driver_install(i2c_master_port, conf.mode, 0, 0, 0);
}

// Full reset + wake with PLL clock source (0x01, NOT 0x00).
// This is the fix for the sensor returning all zeros: 0x00 keeps the
// internal 8MHz RC oscillator as the clock source, which is much more
// sensitive to the electrical noise generated by the motor. 0x01 switches
// to the gyro-X PLL, which is far more stable under that noise.
void mpu6050_reset_and_wake(void) {
    uint8_t reset_buf[2] = {MPU6050_PWR_MGMT_1, 0x80};
    i2c_master_write_to_device(I2C_MASTER_NUM, MPU6050_ADDR, reset_buf, sizeof(reset_buf), 1000 / portTICK_PERIOD_MS);
    vTaskDelay(2000 / portTICK_PERIOD_MS);

    uint8_t wake_buf[2] = {MPU6050_PWR_MGMT_1, 0x01};
    i2c_master_write_to_device(I2C_MASTER_NUM, MPU6050_ADDR, wake_buf, sizeof(wake_buf), 1000 / portTICK_PERIOD_MS);
    vTaskDelay(2000 / portTICK_PERIOD_MS);
}

// Reads WHO_AM_I (must read 104) and Z-axis at rest (must read ~16000)
// to confirm the sensor is actually alive before starting the real tasks.
void mpu6050_health_check(void) {
    uint8_t id_reg = MPU6050_WHO_AM_I;
    uint8_t pwr_reg = MPU6050_PWR_MGMT_1;
    uint8_t accel_reg = MPU6050_ACCEL_XOUT_H;

    uint8_t test_id = 0, test_pwr = 0;
    uint8_t data[6] = {0};

    i2c_master_write_read_device(I2C_MASTER_NUM, MPU6050_ADDR, &id_reg, 1, &test_id, 1, 1000 / portTICK_PERIOD_MS);
    i2c_master_write_read_device(I2C_MASTER_NUM, MPU6050_ADDR, &pwr_reg, 1, &test_pwr, 1, 1000 / portTICK_PERIOD_MS);
    i2c_master_write_read_device(I2C_MASTER_NUM, MPU6050_ADDR, &accel_reg, 1, data, 6, 1000 / portTICK_PERIOD_MS);

    int16_t test_x = (data[0] << 8) | data[1];
    int16_t test_z = (data[4] << 8) | data[5];

    printf("\n=== SENSOR HEALTH CHECK ===\n");
    printf("1. WHO_AM_I ID  (Must be 104): %d\n", test_id);
    printf("2. POWER STATE  (Must be 1 or 0): %d\n", test_pwr);
    printf("3. ACCEL X AXIS : %d\n", test_x);
    printf("4. ACCEL Z AXIS (Must be ~16000): %d\n", test_z);
    printf("===========================\n\n");

    if (test_id != 104) {
        printf("WARNING: WHO_AM_I mismatch - check wiring/address before trusting any data!\n");
    }
}

// ------------------------------------------
// Tasks
// ------------------------------------------

// Core 0: continuous sampling into a ping-pong buffer
extern "C" void core0_sampling_task(void *pvParameters) {
    uint8_t reg_addr = MPU6050_ACCEL_XOUT_H;
    uint8_t data[6];
    int16_t accel_x;
    int sample_index = 0;
    int active_buffer = 0;

    uint32_t i2c_success_count = 0;
    uint32_t i2c_fail_count = 0;
    TickType_t buffer_start_tick = xTaskGetTickCount();

    while (1) {
        esp_err_t ret = i2c_master_write_read_device(I2C_MASTER_NUM, MPU6050_ADDR, &reg_addr, 1, data, 6, portMAX_DELAY);

        if (ret == ESP_OK) {
            i2c_success_count++;
            accel_x = (data[0] << 8) | data[1];

            accel_data_buffer[active_buffer][sample_index] = (float)accel_x;
            sample_index++;

            if (sample_index >= BUFFER_SIZE) {
                sample_index = 0;

                TickType_t now = xTaskGetTickCount();
                uint32_t elapsed_ms = (now - buffer_start_tick) * portTICK_PERIOD_MS;
                printf("DEBUG:success=%lu,fail=%lu,elapsed_ms=%lu\n",
                       (unsigned long)i2c_success_count,
                       (unsigned long)i2c_fail_count,
                       (unsigned long)elapsed_ms);

                i2c_success_count = 0;
                i2c_fail_count = 0;
                buffer_start_tick = now;

                int finished_buffer = active_buffer;
                xQueueSend(ready_buffer_queue, &finished_buffer, 0);
                active_buffer = 1 - active_buffer;
            }
        } else {
            i2c_fail_count++;
        }
        vTaskDelay(10 / portTICK_PERIOD_MS);
    }
}

void calculate_fft(float *real, float *imag, int n) {
    int j = 0;
    for (int i = 0; i < n; i++) {
        if (i < j) {
            float temp = real[i]; real[i] = real[j]; real[j] = temp;
            temp = imag[i]; imag[i] = imag[j]; imag[j] = temp;
        }
        int m = n >> 1;
        while (m >= 1 && j >= m) { j -= m; m >>= 1; }
        j += m;
    }
    for (int size = 2; size <= n; size <<= 1) {
        float angle = -2.0 * 3.14159265 / size;
        float wreal = cos(angle), wimag = sin(angle);
        for (int i = 0; i < n; i += size) {
            float uright_re = 1.0, uright_im = 0.0;
            for (int k = 0; k < size / 2; k++) {
                int idx1 = i + k, idx2 = i + k + size / 2;
                float treal = real[idx2] * uright_re - imag[idx2] * uright_im;
                float timag = real[idx2] * uright_im + imag[idx2] * uright_re;
                real[idx2] = real[idx1] - treal; imag[idx2] = imag[idx1] - timag;
                real[idx1] += treal; imag[idx1] += timag;
                float next_re = uright_re * wreal - uright_im * wimag;
                uright_im = uright_re * wimag + uright_im * wreal; uright_re = next_re;
            }
        }
    }
}

void classify_motor_state(float* my_fft_array) {
    signal_t features_signal;

    int err = numpy::signal_from_buffer(my_fft_array, EI_CLASSIFIER_DSP_INPUT_FRAME_SIZE, &features_signal);
    if (err != 0) {
        printf("Failed to create signal from buffer\n");
        return;
    }

    ei_impulse_result_t result = { 0 };

    err = run_classifier(&features_signal, &result, false);
    if (err != EI_IMPULSE_OK) {
        printf("ERR: Failed to run classifier\n");
        return;
    }

    float normal_score = result.classification[1].value;

    printf("Classification results:\n");
    printf("  Anomaly: %.5f\n", result.classification[0].value);
    printf("  Normal: %.5f\n", result.classification[1].value);

    if (normal_score >= 0.80f) {
        gpio_set_level(LED_GREEN_PIN, 1);
        gpio_set_level(LED_ORANGE_PIN, 0);
        gpio_set_level(LED_RED_PIN, 0);
    } else if (normal_score >= 0.60f && normal_score < 0.80f) {
        printf("WARNING: Motor performance degrading (Score: %.2f)\n", normal_score);
        gpio_set_level(LED_GREEN_PIN, 0);
        gpio_set_level(LED_ORANGE_PIN, 1);
        gpio_set_level(LED_RED_PIN, 0);
    } else {
        printf("!!! EMERGENCY STOP: NORMAL SCORE DROPPED TO %.2f !!!\n", normal_score);
        gpio_set_level(LED_GREEN_PIN, 0);
        gpio_set_level(LED_ORANGE_PIN, 0);
        gpio_set_level(LED_RED_PIN, 1);

        // Uncomment to actually cut power to the motor on critical fault:
        ledc_set_duty(LEDC_MODE, LEDC_CHANNEL, 0);
        ledc_update_duty(LEDC_MODE, LEDC_CHANNEL);
    }
}

// Core 1: FFT + classification on whichever buffer is ready
extern "C" void core1_processing_task(void *pvParameters) {
    int buffer_to_process;
    float imag_buffer[BUFFER_SIZE];
    float magnitude[BUFFER_SIZE / 2];  // 128 bins - matches model input size

    // Skip the first buffer: it may contain stale/settling readings
    // from right after sensor wake-up.
    int buffers_to_skip = 1;

    while (1) {
        if (xQueueReceive(ready_buffer_queue, &buffer_to_process, portMAX_DELAY) == pdTRUE) {

            if (buffers_to_skip > 0) {
                printf("Skipping initial buffer to flush old sensor data...\n");
                buffers_to_skip--;
                continue;
            }

            for (int i = 0; i < BUFFER_SIZE; i++) {
                imag_buffer[i] = 0.0f;
            }

            calculate_fft(accel_data_buffer[buffer_to_process], imag_buffer, BUFFER_SIZE);

            for (int i = 0; i < BUFFER_SIZE / 2; i++) {
                float r = accel_data_buffer[buffer_to_process][i];
                float im = imag_buffer[i];
                magnitude[i] = sqrtf(r * r + im * im);
            }

            classify_motor_state(magnitude);

            for (int i = 0; i < BUFFER_SIZE / 2; i++) {
                printf("%.4f", magnitude[i]);
                if (i < (BUFFER_SIZE / 2) - 1) {
                    printf(",");
                }
            }
            printf("\n");
        }
    }
}

// ==========================================
// Main Application Entry Point
// ==========================================
extern "C" void app_main() {
    init_motor_pwm();
    init_leds();
    i2c_master_init();

    ready_buffer_queue = xQueueCreate(NUM_BUFFERS, sizeof(int));
    if (ready_buffer_queue == NULL) {
        printf("Failed to create queue!\n");
        return;
    }

    ledc_set_duty(LEDC_MODE, LEDC_CHANNEL, 204);
    ledc_update_duty(LEDC_MODE, LEDC_CHANNEL);
    printf("Motor started. Waiting 2 seconds for stabilization...\n");
    vTaskDelay(2000 / portTICK_PERIOD_MS);

    printf("Resetting and waking sensor...\n");
    mpu6050_reset_and_wake();

    mpu6050_health_check();

    printf("Starting AI Sampling...\n");

    xTaskCreatePinnedToCore(core0_sampling_task, "Core_0_Sampling", 4096, NULL, 5, NULL, 0);
    xTaskCreatePinnedToCore(core1_processing_task, "Core_1_Processing", 10240, NULL, 4, NULL, 1);
}
